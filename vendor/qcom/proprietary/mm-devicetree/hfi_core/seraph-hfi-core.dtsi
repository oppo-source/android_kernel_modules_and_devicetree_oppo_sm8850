#include <dt-bindings/interrupt-controller/arm-gic.h>
//#include <dt-bindings/mailbox/qcom-ipcc-seraph.h>
#include <dt-bindings/mailbox/qcom-ipcc.h>

&soc {
	hfi_core_iommu_region_partition: hfi_core_iommu_region_partition {
		iommu-addresses = <&msm_hfi_core 0x0 0x88000000>,
				<&msm_hfi_core 0x90000000 0x70000000>;
	};

	msm_hfi_core: qcom,hfi-core {
		compatible = "qcom,msm-hfi-core";
		status = "ok";

		/* MBOX properties */
		mboxes = <&ipcc_mproc IPCC_CLIENT_DCP 5>,
				<&ipcc_mproc IPCC_CLIENT_DCP 6>,
				<&ipcc_mproc IPCC_CLIENT_APSS 5>,
				<&ipcc_mproc IPCC_CLIENT_APSS 6>;
		interrupt-parent = <&ipcc_mproc>;
		interrupts = <IPCC_CLIENT_DCP 5 IRQ_TYPE_EDGE_RISING>,
				<IPCC_CLIENT_DCP 6 IRQ_TYPE_EDGE_RISING>,
				<IPCC_CLIENT_APSS 5 IRQ_TYPE_EDGE_RISING>,
				<IPCC_CLIENT_APSS 6 IRQ_TYPE_EDGE_RISING>;

		/* DCP properties */
		iommus = <&apps_smmu 0x19A3 0x0>;
		qcom,iommu-group = <&dcp_cb_group>;
		dma-coherent;
		memory-region = <&hfi_core_iommu_region_partition>;

		/* page 1 */
		reg = <0x9ab1000 0x1000>;
		reg-names = "swi_dev0";

		/* firmware map start addr and max size */
		qcom,device-map-addr-reg = <0x88000000 0x8000000>;
	};
};
