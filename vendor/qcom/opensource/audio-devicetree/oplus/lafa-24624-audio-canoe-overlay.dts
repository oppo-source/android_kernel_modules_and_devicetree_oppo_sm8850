/dts-v1/;
/plugin/;

#include <dt-bindings/oplus/hw-id.h>
#include "../canoe-audio-mtp.dts"

#include "canoe-audio-overlay-common.dtsi"
#include "lafa-24624-audio-canoe-overlay.dtsi"

/ {
	model = "Qualcomm Technologies, Inc. Canoe MTP,lafa";

	oplus,project-id = <24624 24776>;
	oplus,hw-id = <OPLUS_T1 OPLUS_EVT1 OPLUS_EVT2 OPLUS_DVT1 OPLUS_DVT2 OPLUS_DVT3 OPLUS_PVT1>;
};

&pmh0110_f_gpios {
	hp_det_1p2_active: hp-det-1p2-active-state {
		pins = "gpio6";
		function = "paired";
		input-enable;
		output-disable;
		power-source = <2>; /* 1.2v */
	};

	hp_det_1p8_active: hp-det-1p8-active-state {
		pins = "gpio5";
		function = "paired";
		input-disable;
		output-enable;
		power-source = <1>; /* 1.8v */
	};
};
