/dts-v1/;
/plugin/;
#include <dt-bindings/oplus/hw-id.h>
#include "../canoe-audio-mtp.dts"
#include "canoe-audio-overlay-common.dtsi"
#include "iceland-25926-canoe-overlay.dtsi"

/ {
    model = "Qualcomm Technologies, Inc. Canoe MTP,iceland";

    oplus,project-id = <25927 25978>;
    oplus,hw-id = <OPLUS_EVB1 OPLUS_EVB2 OPLUS_EVB3 OPLUS_T0 OPLUS_EVT1 OPLUS_EVT2 OPLUS_DVT1 OPLUS_DVT2 OPLUS_PVT1>;
};