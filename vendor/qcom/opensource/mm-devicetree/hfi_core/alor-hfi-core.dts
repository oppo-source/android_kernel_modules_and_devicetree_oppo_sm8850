// SPDX-License-Identifier: BSD-3-Clause
/*
 * Copyright (c) Qualcomm Technologies, Inc. and/or its subsidiaries.
 */

/dts-v1/;
/plugin/;

#include "alor-hfi-core.dtsi"

/ {
	model = "Qualcomm Technologies, Inc. Alor SoC";
	compatible = "qcom,alor";
	qcom,msm-id = <685 0x10000>, <727 0x10000>;
	qcom,board-id = <0 0>;
};
