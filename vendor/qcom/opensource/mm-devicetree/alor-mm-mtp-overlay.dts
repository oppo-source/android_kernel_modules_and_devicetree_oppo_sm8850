// SPDX-License-Identifier: BSD-3-Clause
/*
 * Copyright (c) Qualcomm Technologies, Inc. and/or its subsidiaries.
 */

/dts-v1/;
/plugin/;

#include "hw_fence/alor-hw-fence.dtsi"
#include "hfi_core/alor-hfi-core.dtsi"

/ {
	model = "Qualcomm Technologies, Inc. Alor MTP + wcn7750 WLAN + SN220U + Kundu";
	compatible = "qcom,alor-mtp", "qcom,alor", "qcom,mtp";
	qcom,msm-id = <685 0x10000>, <727 0x10000>;
	qcom,board-id = <0x10008 0>, <0x20008 0>, <0x30008 0>;
};
