// SPDX-License-Identifier: BSD-3-Clause
/*
 * Copyright (c) Qualcomm Technologies, Inc. and/or its subsidiaries.
 */

/dts-v1/;
/plugin/;

#include "hw_fence/alor-hw-fence.dtsi"
#include "hfi_core/alor-hfi-core.dtsi"

/ {
	model = "Qualcomm Technologies, Inc. Alor RCM + wcn7750 WLAN + SN220U + Kundu";
	compatible = "qcom,alor-rcm", "qcom,alor", "qcom,rcm";
	qcom,msm-id = <685 0x10000>, <727 0x10000>;
	qcom,board-id = <0x10015 0>, <0x20015 0>;
};
