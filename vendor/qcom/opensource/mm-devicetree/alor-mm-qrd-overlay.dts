// SPDX-License-Identifier: BSD-3-Clause
/*
 * Copyright (c) Qualcomm Technologies, Inc. and/or its subsidiaries.
 */

/dts-v1/;
/plugin/;

#include "hw_fence/alor-hw-fence.dtsi"
#include "hfi_core/alor-hfi-core.dtsi"

/ {
	model = "Qualcomm Technologies, Inc. Alor QRD + wcn7750 WLAN + SN220U + Kundu";
	compatible = "qcom,alor-qrd", "qcom,alor", "qcom,qrd";
	qcom,msm-id = <685 0x10000>, <727 0x10000>;
	qcom,board-id = <0x1000b 0>,<0x2000b 0>;
};
