// SPDX-License-Identifier: BSD-3-Clause

/*
* Copyright (c) Qualcomm Technologies, Inc. and/or its subsidiaries.
 */

/dts-v1/;
/plugin/;

#include "x1e80100-kiwi-bt.dtsi"

/ {
  model = "Qualcomm Technologies, Inc. X1E80100 SOC";
  compatible = "qcom,kiwi";
  qcom,msm-id = <555 0x10000>, <555 0x20000>;
  qcom,board-id = <40 0>;
};


