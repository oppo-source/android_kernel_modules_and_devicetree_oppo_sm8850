// SPDX-License-Identifier: BSD-3-Clause
/*
 * Copyright (c) Qualcomm Technologies, Inc. and/or its subsidiaries.
 */

/dts-v1/;
/plugin/;

#include "x1e80100-dsp.dtsi"

/ {
	model = "Qualcomm Technologies, Inc. x1e80100 SoC";
	compatible = "qcom,x1e80100";
	qcom,msm-id = <555 0x10000>;
	qcom,board-id = <0 0>;
};
