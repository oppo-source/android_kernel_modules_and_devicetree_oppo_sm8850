// SPDX-License-Identifier: BSD-3-Clause
/*
 * Copyright (c) 2024 Qualcomm Innovation Center, Inc. All rights reserved.
 */

/dts-v1/;
/plugin/;

#include <dt-bindings/clock/qcom,gcc-canoe.h>
#include <dt-bindings/clock/qcom,camcc-canoe.h>
#include <dt-bindings/clock/qcom,cambistmclkcc-canoe.h>
#include <dt-bindings/interconnect/qcom,canoe.h>
#include <dt-bindings/interrupt-controller/arm-gic.h>
#include <dt-bindings/regulator/qcom,rpmh-regulator-levels.h>
#include <dt-bindings/clock/qcom,rpmh.h>
#include <dt-bindings/oplus/hw-id.h>

#include "lafa-camera-sensor-mtp-T0.dtsi"
/ {
	model = "Qualcomm Technologies, Inc. canoe/honu/lafa MTP";
	compatible = "qcom,canoe", "qcom,canoep", "qcom,canoe-mtp",
		"qcom,canoep-mtp", "qcom,mtp";
	oplus,project-id = <24624 24776>;
        oplus,hw-id = <OPLUS_EVB1 OPLUS_EVB2 OPLUS_EVB3 OPLUS_T0>;
};
