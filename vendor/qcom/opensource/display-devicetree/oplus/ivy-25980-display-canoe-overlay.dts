/dts-v1/;
/plugin/;
#include "../display/canoe-sde-display-mtp-overlay.dts"
#include "canoe-display-overlay-common.dtsi"
#include "ivy-25928-display-canoe-overlay.dtsi"

/ {
	model = "Qualcomm Technologies, Inc. Canoe MTP,ivy";

	oplus,project-id = <25980>;
};