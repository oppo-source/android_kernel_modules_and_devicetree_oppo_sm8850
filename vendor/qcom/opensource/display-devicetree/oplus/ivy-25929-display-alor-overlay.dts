/dts-v1/;
/plugin/;
#include "../display/alor-sde-display-mtp-overlay.dts"
#include "alor-display-overlay-common.dtsi"
#include "ivy-25928-display-alor-overlay.dtsi"

/ {
	model = "Qualcomm Technologies, Inc. Alor MTP,ivy";

	oplus,project-id = <25929>;
};
