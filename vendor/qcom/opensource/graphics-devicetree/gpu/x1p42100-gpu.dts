// SPDX-License-Identifier: BSD-3-Clause
/*
 * Copyright (c) Qualcomm Technologies, Inc. and/or its subsidiaries.
 */

/dts-v1/;
/plugin/;

#include <dt-bindings/clock/qcom,aop-qmp.h>
#include <dt-bindings/clock/qcom,rpmh.h>
#include <dt-bindings/clock/qcom,x1e80100-gpucc.h>
#include <dt-bindings/clock/qcom,x1p42100-gcc.h>
#include <dt-bindings/interconnect/qcom,x1p42100.h>
#include <dt-bindings/interrupt-controller/arm-gic.h>
#include <dt-bindings/regulator/qcom,rpmh-regulator-levels.h>

#include "x1p42100-gpu.dtsi"
#include "x1p42100-gpu-pwrlevels.dtsi"

/ {
	model = "Qualcomm Technologies, Inc. X1P42100 SoC";
	compatible = "qcom,x1p42100";
	qcom,msm-id = <635 0x10000>;
	qcom,board-id = <0 0>;
};
