/dts-v1/;
/plugin/;
#include "../qcom/canoe-mtp-overlay.dtso"
#include <dt-bindings/oplus/hw-id.h>
#include "canoe_overlay_common.dtsi"
#include "iceland_overlay_common.dtsi"
#include "oplus_misc/oplus-misc-25926.dtsi"
#include "sensor/iceland-sensor-25926.dtsi"
#include "tp/iceland-oplus-tp-25926.dtsi"
#include "mm/iceland-25926-canoe-mm.dtsi"

#include "oplus_chg/iceland_ivy/oplus-chg-iceland-CN.dtsi"
#include "oplus_pogo_kb/iceland-oplus-pogopin-kb.dtsi"

/ {
    model = "Qualcomm Technologies, Inc. Canoe MTP,iceland";
    oplus,project-id = <25926>;
    oplus,hw-id = <OPLUS_EVB1 OPLUS_EVB2 OPLUS_EVB3 OPLUS_T0 OPLUS_EVT1 OPLUS_EVT2 OPLUS_DVT1 OPLUS_DVT2 OPLUS_PVT1>;
};

