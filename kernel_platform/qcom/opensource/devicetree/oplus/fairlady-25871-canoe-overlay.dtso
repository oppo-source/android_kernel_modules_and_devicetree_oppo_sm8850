/dts-v1/;
/plugin/;
#include "../qcom/canoe-mtp-overlay.dtso"
#include <dt-bindings/oplus/hw-id.h>
#include "canoe_overlay_common.dtsi"
#include "oplus_chg/oplus-chg-25821.dtsi"
#include "oplus_chg/oplus-chg-25871.dtsi"
#include "fairlady_overlay_common.dtsi"
#include "sensor/fairlady-sensor-25821.dtsi"
#include "oplus_uff/oplus-uff-25821.dtsi"
#include "mm/fairlady-25821-canoe-mm.dtsi"
#include "security/fairlady-25821-canoe-security.dtsi"
#include "oplus_nfc/fairlady-sn220.dtsi"
#include "tp/fairlady-oplus-tp-25821.dtsi"
#include "oplus_misc/oplus-misc-25821.dtsi"
#include "oplus_icc/fairlady-25821-icc.dtsi"

/ {
    model = "Qualcomm Technologies, Inc. Canoe MTP,fairlady";
    oplus,project-id = <25871>;
    oplus,hw-id = <OPLUS_EVB1 OPLUS_EVB2 OPLUS_EVB3 OPLUS_T0 OPLUS_T1 OPLUS_EVT1 OPLUS_EVT2 OPLUS_DVT1 OPLUS_DVT2 OPLUS_PVT1>;
};
