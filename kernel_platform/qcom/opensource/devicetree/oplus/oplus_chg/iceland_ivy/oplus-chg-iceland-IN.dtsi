/* IN QBG */
#include "oplus-chg-iceland-common.dtsi"
#include "oplus-chg-iceland-qbg.dtsi"
#include "oplus-chg-iceland-80w.dtsi"

&soc {
	oplus_cpa: oplus,cpa {
		compatible = "oplus,cpa";
		/* format: <protocol_type power_w> */
		oplus,protocol_list = <	CHG_PROTOCOL_VOOC 80
					CHG_PROTOCOL_PPS  55
					CHG_PROTOCOL_PD   13
					CHG_PROTOCOL_QC   13>;
		oplus,default_protocol_list = <	CHG_PROTOCOL_VOOC
						CHG_PROTOCOL_PPS
						CHG_PROTOCOL_PD>;
	};
};

&maxim_encryption_gauge {
	/* CN:611307000110 
	   IN:611307000112
	*/
	oplus,batt_info = /bits/ 8 <0x36 0x31 0x31 0x33 0x30 0x37 0x30 0x30 0x30 0x31 0x31 0x30
				    0x36 0x31 0x31 0x33 0x30 0x37 0x30 0x30 0x30 0x31 0x31 0x32>;
};

&oplus_monitor {
	track,wired_max_power = <80000>;
};