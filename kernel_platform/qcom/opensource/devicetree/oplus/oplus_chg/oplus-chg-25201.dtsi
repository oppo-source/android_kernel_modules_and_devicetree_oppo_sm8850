#include "oplus-chg-25001.dtsi"
#include "oplus-chg-25001-main-gauge.dtsi"

&oplus_cpa {
		oplus,protocol_list = <CHG_PROTOCOL_VOOC 80
				       CHG_PROTOCOL_PPS  55
				       CHG_PROTOCOL_PD   18
				       CHG_PROTOCOL_QC   18>;
		oplus,default_protocol_list = <CHG_PROTOCOL_VOOC
					       CHG_PROTOCOL_PPS
					       CHG_PROTOCOL_PD>;
};