// SPDX-License-Identifier: BSD-3-Clause
/*
 * Copyright (c) Qualcomm Technologies, Inc. and/or its subsidiaries.
 */

/dts-v1/;

#include "khaje-3gb.dtsi"

/ {
	model = "Qualcomm Technologies, Inc. Khaje 3Gb SoC";
	compatible = "qcom,khaje";
	qcom,board-id = <0 0x500>;
};
