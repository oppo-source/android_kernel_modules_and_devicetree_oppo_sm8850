// SPDX-License-Identifier: BSD-3-Clause
/*
 * Copyright (c) Qualcomm Technologies, Inc. and/or its subsidiaries.
 */

/dts-v1/;

#include "canoep-sg.dtsi"

/ {
	model = "Qualcomm Technologies, Inc. CanoeP SG SoC";
	compatible = "qcom,canoep";
	qcom,board-id = <0 0>;
};
