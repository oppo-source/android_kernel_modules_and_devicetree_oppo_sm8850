// SPDX-License-Identifier: BSD-3-Clause
/*
 * Copyright (c) Qualcomm Technologies, Inc. and/or its subsidiaries.
 */

/dts-v1/;

#include "khajeq.dtsi"

/ {
	model = "Qualcomm Technologies, Inc. Khajeq SoC";
	compatible = "qcom,khajeq";
	qcom,board-id = <0 0>;
};
