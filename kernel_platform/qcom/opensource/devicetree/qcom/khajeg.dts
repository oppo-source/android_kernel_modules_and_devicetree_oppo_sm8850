// SPDX-License-Identifier: BSD-3-Clause
/*
 * Copyright (c) Qualcomm Technologies, Inc. and/or its subsidiaries.
 */

/dts-v1/;

#include "khajeg.dtsi"

/ {
	model = "Qualcomm Technologies, Inc. Khajeg SoC";
	compatible = "qcom,khajeg";
	qcom,board-id = <0 0>;
};
