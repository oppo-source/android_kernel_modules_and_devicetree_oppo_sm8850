// SPDX-License-Identifier: BSD-3-Clause
/*
 * Copyright (c) Qualcomm Technologies, Inc. and/or its subsidiaries.
 */

/dts-v1/;
/plugin/;

#include "canoe-mtp-kiwi.dtsi"

/ {
	model = "Qualcomm Technologies, Inc. Canoe MTP + Kiwi WLAN + SN300U + Pandeiro";
	compatible = "qcom,canoe-mtp", "qcom,canoe", "qcom,canoep-mtp", "qcom,canoep",
			   "qcom,mtp";
	qcom,msm-id = <660 0x10000>, <660 0x20000>, <661 0x10000>, <661 0x20000>,
		      <0x1000294 0x10000>, <0x1000294 0x20000>,
		      <0x1000295 0x10000>, <0x1000295 0x20000>,
		      <722 0x30000>, <723 0x30000>,
		      <743 0x10000>, <743 0x20000>;
	qcom,board-id = <0x20008 0>;
};
