// SPDX-License-Identifier: BSD-3-Clause
/*
 * Copyright (c) Qualcomm Technologies, Inc. and/or its subsidiaries.
 */
#include <dt-bindings/clock/qcom,x1p42100-gcc.h>

&soc {
	qup2_se_iommu_region: qup2_se_iommu_region {
		iommu-addresses = <&qupv3_id_2 0x0 0x0 0x0 0x40000000>,
				  <&qupv3_id_2 0x0 0x50000000 0xffffffff 0xb0000000>;
	};

	qupv3_id_2: qcom,qupv3_2_geni_se@8c0000 {
		compatible = "qcom,geni-se-qup";
		reg = <0x0 0x8c0000 0x0 0x2000>;
		clock-names = "m-ahb", "s-ahb";
		clocks = <&gcc GCC_QUPV3_WRAP_2_M_AHB_CLK>,
			 <&gcc GCC_QUPV3_WRAP_2_S_AHB_CLK>;
		iommus = <&apps_smmu 0x0423 0x0>;
		memory-region = <&qup2_se_iommu_region>;
		qcom,iommu-geometry = <0x40000000 0x10000000>;
		qcom,iommu-dma = "fastmap";
		dma-coherent;
		#address-cells = <2>;
		#size-cells = <2>;
		ranges;
		status = "okay";

		qupv3_se21_2uart: qcom,qup_uart@894000 {
			compatible = "qcom,geni-debug-uart";
			reg = <0x0 0x894000 0x0 0x4000>;
			reg-names = "se_phys";
			interrupts = <GIC_SPI 813 IRQ_TYPE_LEVEL_HIGH>;
			clock-names = "se";
			clocks = <&gcc GCC_QUPV3_WRAP2_S5_CLK>;
			pinctrl-names = "default", "sleep";
			pinctrl-0 = <&qupv3_se21_2uart_active>;
			pinctrl-1 = <&qupv3_se21_2uart_sleep>;
			status = "disabled";
		};
	};
};
