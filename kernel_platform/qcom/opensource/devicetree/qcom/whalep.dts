// SPDX-License-Identifier: BSD-3-Clause
/*
 * Copyright (c) Qualcomm Technologies, Inc. and/or its subsidiaries.
 */

/dts-v1/;

#include "whalep.dtsi"

/ {
	model = "Qualcomm Technologies, Inc. WhaleP SoC";
	compatible = "qcom,whalep";
	qcom,board-id = <0 0>;
};
