// SPDX-License-Identifier: BSD-3-Clause
/*
 * Copyright (c) Qualcomm Technologies, Inc. and/or its subsidiaries.
 */

/dts-v1/;

#include "khajep.dtsi"

/ {
	model = "Qualcomm Technologies, Inc. Khajep SoC";
	compatible = "qcom,khajep";
	qcom,board-id = <0 0>;
};
