// SPDX-License-Identifier: BSD-3-Clause
/*
 * Copyright (c) Qualcomm Technologies, Inc. and/or its subsidiaries.
 */

/dts-v1/;

#include "canoep-sg-v2.dtsi"

/ {
	model = "Qualcomm Technologies, Inc. CanoeP SG v2 SoC";
	compatible = "qcom,canoep";
	qcom,board-id = <0 0>;
};
