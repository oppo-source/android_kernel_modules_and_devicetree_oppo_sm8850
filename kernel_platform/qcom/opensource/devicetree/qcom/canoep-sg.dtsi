// SPDX-License-Identifier: BSD-3-Clause
/*
 * Copyright (c) Qualcomm Technologies, Inc. and/or its subsidiaries.
 */

#include "canoep.dtsi"

/ {
	model = "Qualcomm Technologies, Inc. CanoeP SG";
	compatible = "qcom,canoep";
	qcom,msm-id = <743 0x10000>;
};
