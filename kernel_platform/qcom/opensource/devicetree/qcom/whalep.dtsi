// SPDX-License-Identifier: BSD-3-Clause
/*
 * Copyright (c) Qualcomm Technologies, Inc. and/or its subsidiaries.
 */

#include "whale.dtsi"

/ {
	model = "Qualcomm Technologies, Inc. WhaleP SoC";
	compatible = "qcom,whalep";
	qcom,msm-id = <723 0x30000>;
};
