// SPDX-License-Identifier: BSD-3-Clause
/*
 * Copyright (c) Qualcomm Technologies, Inc. and/or its subsidiaries.
 */

/dts-v1/;

#include "khajeg.dtsi"
#include "khajeg-qrd.dtsi"
#include "khaje-qrd-pm7250b.dtsi"

/ {
	model = "Qualcomm Technologies, Inc. Khajeg QRD";
	compatible = "qcom,khajeg-qrd", "qcom,khajeg", "qcom,qrd";
	qcom,board-id = <0x1000B 0>;
};
