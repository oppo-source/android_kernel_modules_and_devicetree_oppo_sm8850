// SPDX-License-Identifier: BSD-3-Clause
/*
 * Copyright (c) Qualcomm Technologies, Inc. and/or its subsidiaries.
 */

#include "canoep-v2.dtsi"

/ {
	model = "Qualcomm Technologies, Inc. CanoeP SG v2";
	compatible = "qcom,canoep";
	qcom,msm-id = <743 0x20000>;
};
