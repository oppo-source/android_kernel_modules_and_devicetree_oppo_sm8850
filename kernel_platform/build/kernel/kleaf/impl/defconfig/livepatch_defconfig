## kernel_platform/build/kernel/kleaf/impl/defconfig/livepatch_defconfig
```kconfig
# debugfs
CONFIG_DEBUG_FS=y
CONFIG_DEBUG_FS_ALLOW_ALL=y

# frace
CONFIG_FTRACE=y
CONFIG_DYNAMIC_FTRACE=y
CONFIG_FUNCTION_TRACER=y

# unwinder
CONFIG_UNWINDER_ORC=y

# livepatch
CONFIG_LIVEPATCH=y
```

## kernel_platform/qcom/opensource/devicetree/bindings/clock/qcom,av1ecc.yaml
```yaml
# SPDX-License-Identifier: (GPL-2.0-only OR BSD-2-Clause)
%YAML 1.2
---
$id: http://devicetree.org/schemas/clock/qcom,av1ecc.yaml#
$schema: http://devicetree.org/meta-schemas/core.yaml#

title: Qualcomm Technologies, Inc. AV1E Clock Controller

maintainers:
  - Taniya Das <quic_tdas@quicinc.com>
  - Kalpak Kawadkar <quic_kkawadka@quicinc.com>

description: |
  AV1E clock control module which supports the clocks, resets and
  power domains on Qualcomm SoCs.

  See also:
    dt-bindings/clock/qcom,x1p42100-av1ecc.h

properties:
  compatible:
    enum:
      - qcom,x1p42100-av1ecc

  clocks:
    items:
      - description: Board XO source
      - description: Sleep clock source
      - description: AV1E's AHB clock

  clock-names:
    items:
      - const: bi_tcxo
      - const: sleep_clk
      - const: iface

  '#clock-cells':
    const: 1

  '#reset-cells':
    const: 1

  '#power-domain-cells':
    const: 1

  reg:
    maxItems: 1

  power-domains:
    description:
      A phandle and PM domain specifier for the MMCX power domain.
    maxItems: 1

  required-opps:
    description:
      A phandle to an OPP node describing required MMCX performance point.
    maxItems: 1

required:
  - compatible
  - reg
  - clocks
  - clock-names
  - '#clock-cells'
  - '#reset-cells'
  - '#power-domain-cells'

additionalProperties: false

examples:
  - |
    #include <dt-bindings/clock/qcom,rpmh.h>
    #include <dt-bindings/power/qcom-rpmpd.h>
    clock-controller@15220000 {
      compatible = "qcom,x1p42100-av1ecc";
      reg = <0x15220000 0x14000>;
      clocks = <&rpmhcc RPMH_CXO_CLK>;
      clock-names = "bi_tcxo";
      #clock-cells = <1>;
      #reset-cells = <1>;
      #power-domain-cells = <1>;
      power-domains = <&rpmhpd RPMHPD_MMCX>;
      required-opps = <&rpmhpd_opp_low_svs>;
    };
...
```

## kernel_platform/qcom/opensource/devicetree/bindings/clock/qcom,sm6115-lpasscc.yaml
```yaml
# SPDX-License-Identifier: (GPL-2.0-only OR BSD-2-Clause)
%YAML 1.2
---
$id: http://devicetree.org/schemas/clock/qcom,sm6115-lpasscc.yaml#
$schema: http://devicetree.org/meta-schemas/core.yaml#

title: Qualcomm LPASS Core Clock Controller for SM6115

maintainers:
  - Taniya Das <quic_tdas@quicinc.com>
  - Chetan C R <quic_cchinnad@quicinc.com>

description: |
  Qualcomm LPASS core clock control module which supports the clocks and
  Reset Controller Binding on SM6115.

  See also:
  - dt-bindings/clock/qcom,lpassaoncc-khaje.h
  - dt-bindings/clock/qcom,lpassaudiocc-khaje.h

properties:
  compatible:
    enum:
      - qcom,lpassaoncc-khaje
      - qcom,lpassaudiocc-khaje

  clocks:
    items:
      - description: Board XO source

  clock-names:
    items:
      - const: bi_tcxo

  vdd_lpi_cx-supply:
    description: Phandle pointer to the vdd_cx L3A_LEVEL logic rail supply

  '#clock-cells':
    const: 1

  '#reset-cells':
    const: 1

  reg:
    items:
      - description: LPASS cc_base register

  reg-names:
    items:
      - const: cc_base

required:
  - compatible
  - reg
  - clocks
  - clock-names
  - '#clock-cells'

additionalProperties: false

examples:
  - |
    #include <dt-bindings/clock/qcom,rpmcc.h>
    #include <dt-bindings/clock/qcom,lpassaoncc-khaje.h>
    #include <dt-bindings/clock/qcom,lpassaudiocc-khaje.h>
    lpassaoncc: clock-controller@a780000 {
       status = "disabled";
       compatible = "qcom,lpassaoncc-khaje", "syscon";
       reg = <0xa780000 0x30000>;
       reg-name = "cc_base";
       vdd_lpi_cx-supply = <&L3A_LEVEL>;
       clocks = <&rpmcc RPM_SMD_XO_CLK_SRC>;
       clock-names = "bi_tcxo";
       #clock-cells = <1>;
       #reset-cells = <1>;
    };
...
```

## vendor/oplus/kernel/cpu/geas/cpu/Kconfig
```kconfig
config OPLUS_FEATURE_GEAS_CPU
        tristate "geas cpu"
        depends on OPLUS_FEATURE_GEAS
        default n
        help
          turning for game
```

## vendor/oplus/kernel/power/power_hook/Kconfig
```kconfig
config OPLUS_FEATURE_POWER_HOOK
	tristate "config to power hook feature"
	default n
	help
	  This selects to config power hook feature

config OPLUS_FEATURE_IRQ_WAKEUP_HOOK
	tristate "config to hook no suspend irq from s2idle"
	default n
	help
	  This selects to hook no suspend irq which triggered from s2idle

config OPLUS_FEATURE_ALARMTIMER_HOOK
	tristate "config to alarmtimer hook"
	default n
	help
	  This selects to hook alarmtimer

config OPLUS_FEATURE_NETLINK_HOOK
	tristate "config to alarmtimer hook"
	default n
	help
	  This selects to hook netlink wakeupsource

config OPLUS_FEATURE_SUSPEND_RESUME_HOOK
	tristate "suspend resume debug module for tracing suspend and resume"
	default n
	help
	  This module adds debug instrumentation to suspend and resume
	  to trace suspend entry and suspend exit time.
```

## vendor/oplus/secure/biometrics/fingerprints/bsp/uff/driver/fp_notify/Kconfig
```kconfig
config UFF_FINGERPRINT_NOTIFY
    tristate "fingerprint notify"
    help
      Say Y here if you have fingerprint notify build into driver.
      Say M here if you have fingerprint notify as module.
```

## vendor/oplus/sensor/kernel/oplus_sensor_err/Kconfig
```kconfig
config OPLUS_FEATURE_TRACE_SENSOR_ERR
	tristate "sensor error trace support"
	help
	  When this option is enabled, sensor error information will be
	  recorded via kernel tracepoint named "sensor_err" for sensors-hal.
	  The trace event format matches oplusSensorErrToStatsd function.
```

## vendor/oplus/sensor/kernel/sensorhub/data_record/Kconfig
```kconfig
config OPLUS_SENSOR_DATA_RECORD
	tristate "for oplus data record"
	default n
	help
	  It support sensor data record.
```

## vendor/qcom/opensource/mm-drivers/hfi_core/Kconfig
```kconfig
config QTI_HFI_CORE
	bool "HFI Core"
	depends on QCOM_SMEM
	select QCOM_MDT_LOADER if ARCH_QCOM
	select QCOM_SCM
	select QCOM_PIL_INFO
	help
	  Enable the hfi_core module

config HFI_CORE_DEBUG_FS
	bool "HFI Core Debug"
	help
	  Enable the hfi_core debug module

config HFI_CORE_SERAPH
	bool "HFI Core Seraph"
	help
	  flag for seraph target
```
